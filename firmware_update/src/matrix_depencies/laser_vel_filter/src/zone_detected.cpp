#include <ros/ros.h>
#include <sensor_msgs/LaserScan.h>
#include <std_msgs/Float32.h>
#include <std_msgs/Int8.h>
#include <std_msgs/Int32.h>

#include <laser_vel_filter/zone_mode.h>
#include <algorithm>

#include <dynamic_reconfigure/DoubleParameter.h>
#include <dynamic_reconfigure/Reconfigure.h>
#include <dynamic_reconfigure/Config.h>
#include <mission_msgs/RobotOptions.h>
#include <web_interface_msgs/Zones.h>

class Laser_vel_filter
{
    private:
        ros::NodeHandle n_;
        ros::Publisher pub_max_vel_, pub_zone_detected;
        ros::Subscriber sub_scan_, sub_web_layout, sub_uvc_state, sub_robot_uvc_option;
        ros::ServiceServer srv_mode_;

        sensor_msgs::LaserScan from_scan_;

        enum MODE{  DISABLE,
                    ENABLE
                 };



        bool scan_comeup_ = false;
        int mode_ = MODE::ENABLE ;
        int beam_detect = 0;
        int decided_threshold = 300;

        float layout_static_vel = 1.2;
        float laser_dynamics_vel = 1.2;

        float max_old=0.0;

        // float zone350[1024] = {0.000000, 0.000000, 0.000000, 0.000000, 0.808000, 0.808000, 0.808000, 0.808000, 0.804000, 0.804000, 0.804000, 0.802000, 0.802000,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 0.822000, 0.826000};
        
        
        float zone400[3001] = {0.825337, 0.825860, 0.826902, 0.826534, 0.825940, 0.825568, 0.827853, 0.827478, 0.830647, 31.000000, 0.834703, 0.835716, 0.835334,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 0.825539, 31.000000};
        
        
        
        float zone600[3001] = {0.843634, 0.844697, 0.844858, 0.845016, 0.845541, 0.846065, 0.845841, 0.844715, 31.000000, 0.848427, 31.000000, 0.852516, 0.854816,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 0.843464, 31.000000};
        


        float zone850[3001] = {0.817304, 0.816572, 0.815838, 0.816353, 0.817007, 0.816263, 0.817652, 0.817783, 0.817910, 0.818033, 0.819413, 31.000000, 0.823432,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 0.818033, 31.000000};
        // float zone1350[1024] = {0.000000, 0.000000, 0.000000, 0.000000, 0.812000, 0.812000, 0.812000, 0.812000, 0.804000, 0.804000, 0.802000, 0.802000, 0.798000,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 0.792000, 0.794000};
       
        struct speed
        {
            float zone350 = 0.3;
            float zone400 = 0.3;
            float zone600 = 0.5;
            float zone850 = 0.7;
            float zone1350 = 1.2;
        };

        speed set_max_speed;

        // zone_speed red_zone, yellow_zone, green_zone;

        enum ZONE{  INIT,
                    ZONE_350,
                    ZONE_400,
                    ZONE_600,
                    ZONE_850,
                    ZONE_1350,
                    OUT_ZONE,
                    DISABLE_ZONE
                    };
        
        
        float uvc_set_vel = 1.2;
        bool uvc_state = false;


    public:
        Laser_vel_filter()
        {
            // pub_max_vel_ = n_.advertise<std_msgs::Float32>("/max_vel", 1);
            pub_zone_detected = n_.advertise<std_msgs::Int8>("/zone_detector", 1);

            sub_scan_ = n_.subscribe("/scan", 1, &Laser_vel_filter::cbScan, this);
            // sub_web_layout = n_.subscribe("/robot_zone", 1, &Laser_vel_filter::cbWebLayout, this);
            // sub_uvc_state = n_.subscribe("/aragorn_io/uvc_state", 1, &Laser_vel_filter::cbUVCState, this);
            // sub_robot_uvc_option = n_.subscribe("/robot_options", 1, &Laser_vel_filter::cbRobotOptions, this);

            // srv_mode_ = n_.advertiseService("/laser_vel_filter/mode", &Laser_vel_filter::cbMode, this);


            //ROS_INFO("Start Laser_vel_filter");
            
            ros::Rate loop_rate(50);

            while(ros::ok())
            {
                //if((mode_ == MODE::ENABLE) && (scan_comeup_))
                if(scan_comeup_)
                {
                    ROS_INFO_ONCE("Start Laser_vel_filter");
                    update_max_vel();
                }
                else
                {
                    ROS_ERROR_ONCE("wait scan comeup or Enable mode");
                }
                ros::spinOnce();
                loop_rate.sleep();
            }
        }

        // void cbRobotOptions(const mission_msgs::RobotOptions& robot_options_msg)
        // {
        //     uvc_set_vel = robot_options_msg.uvc_operation.uvc_move_speed;
        //     ROS_INFO("[dynamics max vel]: Uvc option speed is %f m/s", uvc_set_vel);

        // }
        // void cbUVCState(const std_msgs::Int8& uvc_msg)
        // {
        //     // uvc_state = uvc_msg.data;
        //     // uvc_set_vel = (uvc_msg.data == 1) ? 0.1 : 1.0;
        //     uvc_state = uvc_msg.data;
            
        // }


        // void cbWebLayout(const web_interface_msgs::Zones& zone_msg)
        // {
        //     //zone priority more room such as zone in the room; layout return zone 
        //     if(zone_msg.zone_id == 17) //green
        //     {
        //         layout_static_vel = 1.0;
        //     }
        //     else if(zone_msg.zone_id == 18) //yellow
        //     {
        //         layout_static_vel = 0.5;
        //     }
        //     else if(zone_msg.zone_id == 19) //orange
        //     {
        //         layout_static_vel = 0.25;
        //     }
        //     else if(zone_msg.zone_id == 7) // room
        //     {
        //         layout_static_vel = 0.35;
        //     }
        //     else if(zone_msg.zone_id == 10) //door
        //     {
        //         layout_static_vel = 0.3;
        //     }
        //     else
        //     {
        //         layout_static_vel = 1.0;
        //     }

	    // // ROS_INFO("%d %f", zone_msg.data, layout_static_vel);
            
        // }


        bool cbMode(laser_vel_filter::zone_mode::Request &req, laser_vel_filter::zone_mode::Response &res)
        {
            mode_ = (req.mode == MODE::ENABLE) ? MODE::ENABLE : MODE::DISABLE;
            // res.current_mode = mode_;
            res.result = 1;

            return true;
        }

        void cbScan(const sensor_msgs::LaserScan& scan_msg)
        {
            from_scan_ = scan_msg;
            scan_comeup_ = true;
            // printf("scan size  %d\n", sizeof(scan_msg.ranges)/sizeof(scan_msg.ranges[0]));
        }

        int obstacle_zone_detected()
        {
            int zone_search = ZONE::ZONE_350;
            int zone_detect = ZONE::INIT;
            int return_zone = 0;
            beam_detect = 0;

            for(int i=0; i<=5 ; i++)
            {
                switch(zone_search)
                {
                    case ZONE::ZONE_350:
                        // special for matrix uvc
                        // for(int i = 6; i < 1024; i++)
                        // {
                        //     // printf("zone_350 searching\n");
                        //     if(from_scan_.ranges[i] <= zone350[i])
                        //     {
                        //         beam_detect++;
                        //     }
                        // }
                        zone_detect = ZONE::ZONE_350;
                        zone_search = ZONE::ZONE_400;
                        break;
                    
                    case ZONE::ZONE_400:
                        for(int i = 6; i < 3001; i++)
                        {
                            // printf("zone_400 searching\n");
                            if((from_scan_.ranges[i] <= zone400[i]) && (zone600[i] <= from_scan_.range_max))
                            {
                                // printf("scan_position detect %d\n", i);
                                beam_detect++;
                            }
                            // printf("zone 400 beam %d\n", beam_detect);
                        }
                        zone_detect = ZONE::ZONE_400;
                        zone_search = ZONE::ZONE_600;
                        break;
                    
                    case ZONE::ZONE_600:
                        for(int i = 6; i < 3001; i++)
                        {
                            // printf("zone_600 searching\n");
                            if((from_scan_.ranges[i] <= zone600[i]) && (zone600[i] <= from_scan_.range_max))
                            {
                                beam_detect++;
                                // printf("zone 600 beam %d\n", beam_detect);
                            }
                        }
                        zone_detect = ZONE::ZONE_600;
                        zone_search = ZONE::ZONE_850;
                        break;
                    
                    case ZONE::ZONE_850:
                        for(int i = 6; i < 3001; i++) 
                        {
                            // printf("zone_850 searching\n");
                            if((from_scan_.ranges[i] <= zone850[i]) && (zone600[i] <= from_scan_.range_max))
                            {
                                
                                beam_detect++;
                            }
                        }
                        zone_detect = ZONE::ZONE_850;
                        zone_search = ZONE::ZONE_1350;
                        break;
                    
                    case ZONE::ZONE_1350:
                        // special for matrix uvc
                        // for(int i = 6; i < 1024; i++)
                        // {
                        //     // printf("zone_1350 searching\n");
                        //     if(from_scan_.ranges[i] <= zone1350[i])
                        //     {
                        //         beam_detect++;
                        //     }
                        // }
                        zone_detect = ZONE::ZONE_1350;
                        // zone_search = ZONE::ZONE_1350;
                        break;
                }

                printf("zone %d beam %d\n", zone_detect, beam_detect);

                if(beam_detect >= decided_threshold)
                {
                    return_zone = zone_detect;
                    break;
                }
                else
                {
                    return_zone = ZONE_1350;
                }

                beam_detect = 0;
                zone_detect = ZONE::INIT;   
            }

            
            return return_zone;
            
        }

        void update_max_vel()
        {
            

            int car_state = obstacle_zone_detected();

            // int car_state;
            
            printf("%d\n", car_state);

            std_msgs::Float32 max_vel;
            std_msgs::Int8 zone;

            zone.data = car_state;

            if(car_state == ZONE::ZONE_350)
            {
                laser_dynamics_vel = set_max_speed.zone350;
            }
            else if(car_state == ZONE::ZONE_400)
            {
                laser_dynamics_vel = set_max_speed.zone400;
            }
            else if(car_state == ZONE::ZONE_600)
            {
                laser_dynamics_vel = set_max_speed.zone600;
            }
            else if(car_state == ZONE::ZONE_850)
            {
                laser_dynamics_vel = set_max_speed.zone850;
            }
            else if(car_state == ZONE::ZONE_1350)
            {
                laser_dynamics_vel = set_max_speed.zone1350;
            }
            
            // ROS_INFO("Found obstacle in zone : %d reduce speed to %f", car_state, max_vel.data);

            // compaire limit maxspeed form Layout and Dynamics Laser
            // max_vel.data = (laser_dynamics_vel <= layout_static_vel) ? laser_dynamics_vel : layout_static_vel;

            if(mode_ == MODE::ENABLE)
            {
                max_vel.data = std::min(laser_dynamics_vel, layout_static_vel);
            }
            else
            {
                max_vel.data = 1.0;
            }
            
            // if(uvc_state)
            // {
            //     max_vel.data = std::min(max_vel.data, uvc_set_vel);
            // }
            // else
            // {
            //     ; // max_vel.data = 1.0;
            // }
            
            

            // if(max_vel.data != max_old)
            // {
            //     pub_max_vel_.publish(max_vel);
            //     max_old = max_vel.data;
            // }

            //ROS_INFO("%f", max_vel.data);
            
            pub_zone_detected.publish(zone);

        }

};

int main(int argc, char **argv)
{
    //Initiate ROS
    ros::init(argc, argv, "Laser_vel_filter");

    
    
    //Create an object of class SubscribeAndPublish that will take care of everything
    Laser_vel_filter runObject;

    ros::spin();

    return 0;
}
